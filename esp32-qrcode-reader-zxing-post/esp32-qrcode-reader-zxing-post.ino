/*
    HTTP over TLS (HTTPS) example sketch

    This example demonstrates how to use
    WiFiClientSecure class to access HTTPS API.
    We fetch and display the status of
    esp8266/Arduino project continuous integration
    build.

    Limitations:
      only RSA certificates
      no support of Perfect Forward Secrecy (PFS)
      TLSv1.2 is supported since version 2.4.0-rc1

    Created by Ivan Grokhotkov, 2015.
    This example is in public domain.
*/

#include <ESP8266WiFi.h>
#include <WiFiClientSecure.h>
#include "FS.h"

#ifndef STASSID
//#define STASSID "PP-RD-FL4"
//#define STAPSK  "ppetech1"
#define STASSID "true_home2G_350"
#define STAPSK  "88f02350"
#endif

const char* ssid = STASSID;
const char* password = STAPSK;

const char* host = "zxing.org";
const int httpsPort = 443;

// Use web browser to view and copy
// SHA1 fingerprint of the certificate
const char fingerprint[] PROGMEM = "7a 1b 3d 38 b2 d7 5b c1 7f 22 3e 80 c0 75 22 88 19 b1 dd 20";

// qr code jpeg file to hex
const unsigned char img[] PROGMEM = { 
0xFF, 0xD8, 0xFF, 0xE0, 0x00, 0x10, 0x4A, 0x46, 0x49, 0x46, 0x00, 0x01, 0x01, 0x01, 0x00, 0x60, 
0x00, 0x60, 0x00, 0x00, 0xFF, 0xFE, 0x00, 0x3B, 0x43, 0x52, 0x45, 0x41, 0x54, 0x4F, 0x52, 0x3A, 
0x20, 0x67, 0x64, 0x2D, 0x6A, 0x70, 0x65, 0x67, 0x20, 0x76, 0x31, 0x2E, 0x30, 0x20, 0x28, 0x75, 
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0x7D, 0xD1, 0xF5, 0xE7, 0x34, 0x01, 0xFF, 0xD9, 
};

unsigned int imgSize = 11736; //sizeof(img);
  
void setup() {
  Serial.begin(115200);
  Serial.println();

  SPIFFS.begin();
  File f = SPIFFS.open("/line128x128.jpg", "r");
  if (!f) {
    Serial.println("file open failed");
  }  
  Serial.println("f.fileName(), f.size -> " + String(SPIFFS.exists("/line128x128.jpg")) + "," + String(f.name()) + "," + String(f.size())  );
  
  Serial.print("connecting to ");
  Serial.println(ssid);
  WiFi.mode(WIFI_STA);
  WiFi.begin(ssid, password);
  while (WiFi.status() != WL_CONNECTED) {
    delay(500);
    Serial.print(".");
  }
  Serial.println("");
  Serial.println("WiFi connected");
  Serial.println("IP address: ");
  Serial.println(WiFi.localIP());

  // Use WiFiClientSecure class to create TLS connection
  WiFiClientSecure client;
  Serial.print("connecting to ");
  Serial.println(host);

  Serial.printf("Using fingerprint '%s'\n", fingerprint);
  client.setFingerprint(fingerprint);

  if (!client.connect(host, httpsPort)) {
    Serial.println("connection failed");
    return;
  }

  String url = "/w/decode";
  Serial.print("requesting URL: ");
  Serial.println(url);

  String start_request = "";
  start_request = start_request +
  "------WebKitFormBoundaryieIsmGgKag7ktdTw\r\n" +
   "Content-Disposition: form-data; name=\"f\"; filename=\"line128x128.jpg\"\r\n" +
   "Content-Type: image/jpeg\r\n\r\n";
   
  String end_request = "";
  end_request = end_request + "\r\n------WebKitFormBoundaryieIsmGgKag7ktdTw--\r\n";
  
  uint16_t full_length;
  full_length = start_request.length() + imgSize + end_request.length(); //f.size()
  Serial.println("full_length -> " + String(full_length));

  String headerUrl = (String("POST ") + url + " HTTP/1.1\r\n" +
              "Host: " + host + "\r\n" +
              "Connection: keep-alive" + "\r\n" +   
              "Content-Length: " + String(full_length, DEC) + "\r\n" +         
              "Content-Type: multipart/form-data; boundary=----WebKitFormBoundaryieIsmGgKag7ktdTw" + "\r\n" + 
              "User-Agent: BuildFailureDetectorESP8266" + "\r\n\r\n");
  client.print(headerUrl);
  client.print(start_request);
  Serial.println(headerUrl + start_request);

  client.write(img, imgSize);
//  client.write(f);
  
  client.println(end_request);
  Serial.println(end_request);
       
  Serial.println("request sent");
  while (!client.connected()) {
    Serial.println('.');
  }

  String content = "";
  while (client.available()) {
    char ch = static_cast<char>(client.read());
    content += ch;
  }
  
  Serial.println("Content==========");
  Serial.println();
  Serial.println(content);
  Serial.println();
  Serial.println("End content==========");
  Serial.println("closing connection");
}

void loop() {
}
